#include "biba40.dtsi"

&default_transform { 
    col-offset = <6>;
};

&kscan0 {
    col-gpios
        = <&pro_micro d14 GPIO_ACTIVE_HIGH>
        , <&pro_micro d15 GPIO_ACTIVE_HIGH>
        , <&pro_micro d18 GPIO_ACTIVE_HIGH>
        , <&pro_micro d19 GPIO_ACTIVE_HIGH>
        , <&pro_micro d20 GPIO_ACTIVE_HIGH>
        , <&pro_micro d21 GPIO_ACTIVE_HIGH>
        ;
};
