#include "biba40.dtsi"

&kscan0 {
    col-gpios
        = <&gpio0 31 GPIO_ACTIVE_HIGH>
        , <&gpio0 29 GPIO_ACTIVE_HIGH>
        , <&gpio0 2 GPIO_ACTIVE_HIGH>
        , <&gpio0 115 GPIO_ACTIVE_HIGH>
        , <&gpio0 113 GPIO_ACTIVE_HIGH>
        , <&gpio0 111 GPIO_ACTIVE_HIGH>
        ;
};

