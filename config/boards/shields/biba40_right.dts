/ {
    compatible = "zmk,biba40_right";

    &pro_micro {
        pinctrl-names = "default";
        pinctrl-0 = <&pinctrl_biba40_right_default>;

        pinctrl_biba40_right_default: pinctrl {
            pins = <&pro_micro 21 0>,  // Column 1
                  <&pro_micro 20 0>,  // Column 2
                  <&pro_micro 19 0>,  // Column 3
                  <&pro_micro 18 0>,  // Column 4
                  <&pro_micro 15 0>,  // Column 5
                  <&pro_micro 14 0>,  // Column 6
                  <&pro_micro 2 0>,   // Row 1
                  <&pro_micro 3 0>,   // Row 2
                  <&pro_micro 4 0>,   // Row 3
                  <&pro_micro 5 0>;   // Row 4
        };
    };
};