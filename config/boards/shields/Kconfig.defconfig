## config/boards/shields/Kconfig.defconfig
```kconfig
if SHIELD_BIBA40_LEFT

config ZMK_KEYBOARD_NAME
    default "Biba40"

config ZMK_SPLIT_ROLE_CENTRAL
    default y

endif

if SHIELD_BIBA40_LEFT || SHIELD_BIBA40_RIGHT

config ZMK_SPLIT
    default y

endif
```

## config/boards/shields/Kconfig.shield
```kconfig
config SHIELD_BIBA40_LEFT
    def_bool $(shields_list_contains,biba40_left)

config SHIELD_BIBA40_RIGHT
    def_bool $(shields_list_contains,biba40_right)
```

## config/west.yml
```yaml
manifest:
  remotes:
    - name: zmkfirmware
      url-base: https://github.com/zmkfirmware
    - name: custom_shield
      url-base: https://github.com/danbiba

  projects:
    - name: zmk
      remote: zmkfirmware
      revision: main
      import: app/west.yml

    - name: biba_40_shield
      remote: custom_shield
      revision: main
      path: biba_40_shield  # Optional: set the path where you want to clone the shield
      import: .  # Adjust if there's a specific west.yml in the shield repo you want to include

  self:
    path: config
```
